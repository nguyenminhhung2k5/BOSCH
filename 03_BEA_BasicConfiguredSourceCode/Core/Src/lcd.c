/**
  ******************************************************************************
  * @file           : lcd.c
  * @brief          : Robust driver for Waveshare 2.8inch SPI LCD (ST7789)
  *                   with hardware noise suppression & Touch IC isolation
  *                   for BOSCH Embedded Academy Open405R-C
  ******************************************************************************
  */

#include "lcd.h"
#include "font1206.h"
#include <stdio.h>
#include <string.h>

/* Bảng font chuẩn ASCII 8x16 (0x20 ' ' đến 0x7E '~') */
static const uint8_t Font8x16[95][16] = {
    {0x00,0x00,0x00,0x00,0x00,0x00,0x00,0x00,0x00,0x00,0x00,0x00,0x00,0x00,0x00,0x00}, /*   0x20 */
    {0x00,0x00,0x18,0x3C,0x3C,0x3C,0x18,0x18,0x18,0x00,0x18,0x18,0x00,0x00,0x00,0x00}, /* ! 0x21 */
    {0x00,0x66,0x66,0x66,0x24,0x00,0x00,0x00,0x00,0x00,0x00,0x00,0x00,0x00,0x00,0x00}, /* " 0x22 */
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    {0x00,0x76,0xDC,0x00,0x00,0x00,0x00,0x00,0x00,0x00,0x00,0x00,0x00,0x00,0x00,0x00}  /* ~ 0x7E */
};

/* Màu chữ và màu nền mặc định */
static uint16_t s_TextColor = LCD_COLOR_WHITE;
static uint16_t s_BackColor = LCD_COLOR_BLACK;

/* ========================================================================== */
/*           HÀM DELAY SPI ĐỊNH THỜI CHỐNG NHIỄU & XUYÊN ÂM ĐƯỜNG TRUYỀN      */
/* ========================================================================== */
/* Tại 168MHz CPU, 8 NOPs tương đương ~48ns, tạo xung clock SPI sạch ~10MHz,
 * hoàn toàn triệt tiêu sóng phản xạ (ringing) và đáp ứng chuẩn ST7789 */
static inline void LCD_SPI_Delay(void)
{
    __NOP(); __NOP(); __NOP(); __NOP();
    __NOP(); __NOP(); __NOP(); __NOP();
}

/* Gửi 1 byte SPI bit-banging chuẩn Mode 0 (CPOL=0, CPHA=0) */
static inline void LCD_WriteByte_SPI(uint8_t data)
{
    for (uint8_t i = 0; i < 8; i++)
    {
        if (data & 0x80)
        {
            LCD_MOSI_PORT->BSRR = LCD_MOSI_PIN;
        }
        else
        {
            LCD_MOSI_PORT->BSRR = (uint32_t)LCD_MOSI_PIN << 16;
        }

        LCD_SPI_Delay();
        LCD_SCK_PORT->BSRR = LCD_SCK_PIN;                   /* SCK High: ST7789 chốt data */
        LCD_SPI_Delay();
        LCD_SCK_PORT->BSRR = (uint32_t)LCD_SCK_PIN << 16;   /* SCK Low */
        data <<= 1;
    }
}

/* Gửi Command tới ST7789 */
static void LCD_Write_Command(uint8_t cmd)
{
    LCD_DC_PORT->BSRR = (uint32_t)LCD_DC_PIN << 16;         /* DC Low = Lệnh */
    LCD_CS_PORT->BSRR = (uint32_t)LCD_CS_PIN << 16;         /* CS Low */
    LCD_SPI_Delay();
    LCD_WriteByte_SPI(cmd);
    LCD_CS_PORT->BSRR = LCD_CS_PIN;                         /* CS High */
    LCD_SPI_Delay();
}

/* Gửi Data tới ST7789 */
static void LCD_Write_Data(uint8_t data)
{
    LCD_DC_PORT->BSRR = LCD_DC_PIN;                         /* DC High = Dữ liệu */
    LCD_CS_PORT->BSRR = (uint32_t)LCD_CS_PIN << 16;         /* CS Low */
    LCD_SPI_Delay();
    LCD_WriteByte_SPI(data);
    LCD_CS_PORT->BSRR = LCD_CS_PIN;                         /* CS High */
    LCD_SPI_Delay();
}

/* ========================================================================== */
/*                KHỞI TẠO PHẦN CỨNG GPIO & CÔ LẬP TOUCH CONTROLLER           */
/* ========================================================================== */
void LCD_GPIO_Init(void)
{
    __HAL_RCC_GPIOA_CLK_ENABLE();
    __HAL_RCC_GPIOB_CLK_ENABLE();

    GPIO_InitTypeDef GPIO_InitStruct = {0};

    /* 1. MOSI (PA7) */
    GPIO_InitStruct.Pin = LCD_MOSI_PIN;
    GPIO_InitStruct.Mode = GPIO_MODE_OUTPUT_PP;
    GPIO_InitStruct.Pull = GPIO_PULLUP;
    GPIO_InitStruct.Speed = GPIO_SPEED_FREQ_HIGH;
    HAL_GPIO_Init(LCD_MOSI_PORT, &GPIO_InitStruct);

    /* 2. MISO (PA6) - Kéo PULLUP để tránh thả nổi khi Touch IC ngắt */
    GPIO_InitStruct.Pin = LCD_MISO_PIN;
    GPIO_InitStruct.Mode = GPIO_MODE_INPUT;
    GPIO_InitStruct.Pull = GPIO_PULLUP;
    HAL_GPIO_Init(LCD_MISO_PORT, &GPIO_InitStruct);

    /* 3. SCK (PB3), RST (PB2), BL (PB6), CS (PB7), DC (PB8) */
    GPIO_InitStruct.Pin = LCD_SCK_PIN | LCD_RST_PIN | LCD_BL_PIN | LCD_CS_PIN | LCD_DC_PIN;
    GPIO_InitStruct.Mode = GPIO_MODE_OUTPUT_PP;
    GPIO_InitStruct.Pull = GPIO_PULLUP;
    GPIO_InitStruct.Speed = GPIO_SPEED_FREQ_HIGH;
    HAL_GPIO_Init(GPIOB, &GPIO_InitStruct);

    /* 4. ĐẶC BIỆT QUAN TRỌNG: Cấu hình PB9 (TP_CS) là OUTPUT và KÉO LÊN HIGH!
     * Trên board 2.8" LCD, chip Touch XPT2046 dùng chung bus SPI với màn hình.
     * Nếu PB9 bị thả nổi, mỗi khi người dùng dí tay vào hộp / màn hình, chip Touch
     * sẽ kích hoạt và chèn tín hiệu lên bus SPI làm nhiễu vỡ hình hoàn toàn! */
    GPIO_InitStruct.Pin = LCD_TP_CS_PIN;
    GPIO_InitStruct.Mode = GPIO_MODE_OUTPUT_PP;
    GPIO_InitStruct.Pull = GPIO_PULLUP;
    GPIO_InitStruct.Speed = GPIO_SPEED_FREQ_HIGH;
    HAL_GPIO_Init(LCD_TP_CS_PORT, &GPIO_InitStruct);
    HAL_GPIO_WritePin(LCD_TP_CS_PORT, LCD_TP_CS_PIN, GPIO_PIN_SET); /* KHÓA TOUCH IC VĨNH VIỄN */

    /* 5. TP_IRQ (PB4) - Kéo PULLUP */
    GPIO_InitStruct.Pin = LCD_TP_IRQ_PIN;
    GPIO_InitStruct.Mode = GPIO_MODE_INPUT;
    GPIO_InitStruct.Pull = GPIO_PULLUP;
    HAL_GPIO_Init(LCD_TP_IRQ_PORT, &GPIO_InitStruct);

    /* Mức logic mặc định ban đầu */
    HAL_GPIO_WritePin(LCD_CS_PORT, LCD_CS_PIN, GPIO_PIN_SET);
    HAL_GPIO_WritePin(LCD_DC_PORT, LCD_DC_PIN, GPIO_PIN_SET);
    HAL_GPIO_WritePin(LCD_SCK_PORT, LCD_SCK_PIN, GPIO_PIN_RESET);
    HAL_GPIO_WritePin(LCD_BL_PORT, LCD_BL_PIN, GPIO_PIN_SET);       /* Bật đèn nền */
}

/* ========================================================================== */
/*                CHU TRÌNH KHỞI ĐỘNG VÀ HIỆU CHUẨN ST7789                    */
/* ========================================================================== */
void LCD_Init(void)
{
    LCD_GPIO_Init();

    /* Reset phần cứng ST7789 theo chuẩn datasheet */
    HAL_GPIO_WritePin(LCD_RST_PORT, LCD_RST_PIN, GPIO_PIN_RESET);
    HAL_Delay(25);
    HAL_GPIO_WritePin(LCD_RST_PORT, LCD_RST_PIN, GPIO_PIN_SET);
    HAL_Delay(120);

    /* Thoát chế độ Sleep */
    LCD_Write_Command(0x11);
    HAL_Delay(120);

    /* Cấu hình hướng quét màn hình: Chiều dọc (Portrait 240x320) */
    LCD_Write_Command(0x36);
    LCD_Write_Data(0x00);

    /* Định dạng màu sắc: 16-bit RGB 565 */
    LCD_Write_Command(0x3A);
    LCD_Write_Data(0x05);

    /* Porch Setting */
    LCD_Write_Command(0xB2);
    LCD_Write_Data(0x0C); LCD_Write_Data(0x0C);
    LCD_Write_Data(0x00); LCD_Write_Data(0x33); LCD_Write_Data(0x33);

    /* Gate Control */
    LCD_Write_Command(0xB7);
    LCD_Write_Data(0x35);

    /* VCOM Setting */
    LCD_Write_Command(0xBB);
    LCD_Write_Data(0x28);

    /* LCM Control */
    LCD_Write_Command(0xC0);
    LCD_Write_Data(0x2C);

    /* VDV & VRH Command Enable */
    LCD_Write_Command(0xC2);
    LCD_Write_Data(0x01);

    /* VRH Set */
    LCD_Write_Command(0xC3);
    LCD_Write_Data(0x0B);

    /* VDV Set */
    LCD_Write_Command(0xC4);
    LCD_Write_Data(0x20);

    /* Frame Rate Control: 60Hz */
    LCD_Write_Command(0xC6);
    LCD_Write_Data(0x0F);

    /* Power Control 1 */
    LCD_Write_Command(0xD0);
    LCD_Write_Data(0xA4); LCD_Write_Data(0xA1);

    /* Bảng hiệu chuẩn Gamma Dương (Positive Gamma Correction) */
    LCD_Write_Command(0xE0);
    LCD_Write_Data(0xD0); LCD_Write_Data(0x01); LCD_Write_Data(0x08);
    LCD_Write_Data(0x0F); LCD_Write_Data(0x11); LCD_Write_Data(0x2A);
    LCD_Write_Data(0x36); LCD_Write_Data(0x55); LCD_Write_Data(0x44);
    LCD_Write_Data(0x3A); LCD_Write_Data(0x0B); LCD_Write_Data(0x06);
    LCD_Write_Data(0x11); LCD_Write_Data(0x20);

    /* Bảng hiệu chuẩn Gamma Âm (Negative Gamma Correction) */
    LCD_Write_Command(0xE1);
    LCD_Write_Data(0xD0); LCD_Write_Data(0x02); LCD_Write_Data(0x07);
    LCD_Write_Data(0x0A); LCD_Write_Data(0x0B); LCD_Write_Data(0x18);
    LCD_Write_Data(0x34); LCD_Write_Data(0x43); LCD_Write_Data(0x4A);
    LCD_Write_Data(0x2B); LCD_Write_Data(0x1B); LCD_Write_Data(0x1C);
    LCD_Write_Data(0x22); LCD_Write_Data(0x1F);

    /* Đảo màu màn hình (Display Inversion On - chuẩn cho màn ST7789 IPS) */
    LCD_Write_Command(0x21);
    HAL_Delay(10);

    /* Bật hiển thị */
    LCD_Write_Command(0x29);
    HAL_Delay(50);

    /* Xóa sạch màn hình màu đen */
    LCD_Clear(LCD_COLOR_BLACK);
}

/* ========================================================================== */
/*                       HÀM ĐỒ HỌA CƠ BẢN VÀ VẼ KÝ TỰ                        */
/* ========================================================================== */
void LCD_SetWindow(uint16_t x0, uint16_t y0, uint16_t x1, uint16_t y1)
{
    LCD_Write_Command(0x2A); /* Column Addr Set */
    LCD_Write_Data(x0 >> 8);
    LCD_Write_Data(x0 & 0xFF);
    LCD_Write_Data(x1 >> 8);
    LCD_Write_Data(x1 & 0xFF);

    LCD_Write_Command(0x2B); /* Row Addr Set */
    LCD_Write_Data(y0 >> 8);
    LCD_Write_Data(y0 & 0xFF);
    LCD_Write_Data(y1 >> 8);
    LCD_Write_Data(y1 & 0xFF);

    LCD_Write_Command(0x2C); /* Memory Write */
}

void LCD_Clear(uint16_t Color)
{
    LCD_SetWindow(0, 0, LCD_WIDTH - 1, LCD_HEIGHT - 1);

    LCD_DC_PORT->BSRR = LCD_DC_PIN;
    LCD_CS_PORT->BSRR = (uint32_t)LCD_CS_PIN << 16;
    LCD_SPI_Delay();

    uint8_t hi = Color >> 8;
    uint8_t lo = Color & 0xFF;

    for (uint32_t i = 0; i < (LCD_WIDTH * LCD_HEIGHT); i++)
    {
        LCD_WriteByte_SPI(hi);
        LCD_WriteByte_SPI(lo);
    }

    LCD_CS_PORT->BSRR = LCD_CS_PIN;
    LCD_SPI_Delay();
}

void LCD_SetTextColor(uint16_t Color)
{
    s_TextColor = Color;
}

void LCD_SetBackColor(uint16_t Color)
{
    s_BackColor = Color;
}

uint16_t LCD_GetTextColor(void)
{
    return s_TextColor;
}

uint16_t LCD_GetBackColor(void)
{
    return s_BackColor;
}

void LCD_DrawPixel(uint16_t x, uint16_t y, uint16_t color)
{
    if (x >= LCD_WIDTH || y >= LCD_HEIGHT) return;
    LCD_SetWindow(x, y, x, y);

    LCD_DC_PORT->BSRR = LCD_DC_PIN;
    LCD_CS_PORT->BSRR = (uint32_t)LCD_CS_PIN << 16;
    LCD_SPI_Delay();
    LCD_WriteByte_SPI(color >> 8);
    LCD_WriteByte_SPI(color & 0xFF);
    LCD_CS_PORT->BSRR = LCD_CS_PIN;
    LCD_SPI_Delay();
}

void LCD_FillRect(uint16_t x, uint16_t y, uint16_t w, uint16_t h, uint16_t color)
{
    if (x >= LCD_WIDTH || y >= LCD_HEIGHT) return;
    if (x + w > LCD_WIDTH)  w = LCD_WIDTH - x;
    if (y + h > LCD_HEIGHT) h = LCD_HEIGHT - y;

    LCD_SetWindow(x, y, x + w - 1, y + h - 1);

    LCD_DC_PORT->BSRR = LCD_DC_PIN;
    LCD_CS_PORT->BSRR = (uint32_t)LCD_CS_PIN << 16;
    LCD_SPI_Delay();

    uint8_t hi = color >> 8;
    uint8_t lo = color & 0xFF;
    uint32_t total = w * h;

    for (uint32_t i = 0; i < total; i++)
    {
        LCD_WriteByte_SPI(hi);
        LCD_WriteByte_SPI(lo);
    }

    LCD_CS_PORT->BSRR = LCD_CS_PIN;
    LCD_SPI_Delay();
}

void LCD_DrawCharEx(uint16_t x, uint16_t y, char ch, uint16_t textColor, uint16_t bgColor)
{
    if (ch < 0x20 || ch > 0x7E) ch = ' ';
    uint8_t idx = ch - 0x20;

    LCD_SetWindow(x, y, x + 7, y + 15);

    LCD_DC_PORT->BSRR = LCD_DC_PIN;
    LCD_CS_PORT->BSRR = (uint32_t)LCD_CS_PIN << 16;
    LCD_SPI_Delay();

    uint8_t hiText = textColor >> 8;
    uint8_t loText = textColor & 0xFF;
    uint8_t hiBg   = bgColor >> 8;
    uint8_t loBg   = bgColor & 0xFF;

    for (uint8_t row = 0; row < 16; row++)
    {
        uint8_t line = Font8x16[idx][row];
        for (uint8_t col = 0; col < 8; col++)
        {
            if (line & (0x80 >> col))
            {
                LCD_WriteByte_SPI(hiText);
                LCD_WriteByte_SPI(loText);
            }
            else
            {
                LCD_WriteByte_SPI(hiBg);
                LCD_WriteByte_SPI(loBg);
            }
        }
    }

    LCD_CS_PORT->BSRR = LCD_CS_PIN;
    LCD_SPI_Delay();
}

void LCD_DrawChar(uint16_t x, uint16_t y, char ch)
{
    LCD_DrawCharEx(x, y, ch, s_TextColor, s_BackColor);
}

void LCD_DrawStringEx(uint16_t x, uint16_t y, const char *str, uint16_t textColor, uint16_t bgColor)
{
    while (*str)
    {
        if (x + 8 > LCD_WIDTH)
        {
            x = 0;
            y += 16;
            if (y + 16 > LCD_HEIGHT) break;
        }
        LCD_DrawCharEx(x, y, *str++, textColor, bgColor);
        x += 8;
    }
}

void LCD_DrawString(uint16_t x, uint16_t y, const char *str)
{
    LCD_DrawStringEx(x, y, str, s_TextColor, s_BackColor);
}

/* ========================================================================== */
/*                HÀM VẼ FONT CHỮ NHỎ 6x12 (HIỂN THỊ TRỌN VẸN 8 BYTES)         */
/* ========================================================================== */
void LCD_DrawChar6x12Ex(uint16_t x, uint16_t y, char ch, uint16_t textColor, uint16_t bgColor)
{
    if (ch < 0x20 || ch > 0x7E) ch = ' ';
    uint8_t idx = (uint8_t)(ch - 0x20);

    if (x + 6 > LCD_WIDTH || y + 12 > LCD_HEIGHT) return;

    LCD_SetWindow(x, y, x + 5, y + 11);

    LCD_DC_PORT->BSRR = LCD_DC_PIN;
    LCD_CS_PORT->BSRR = (uint32_t)LCD_CS_PIN << 16;
    LCD_SPI_Delay();

    uint8_t hiText = textColor >> 8;
    uint8_t loText = textColor & 0xFF;
    uint8_t hiBg   = bgColor >> 8;
    uint8_t loBg   = bgColor & 0xFF;

    for (uint8_t row = 0; row < 12; row++)
    {
        uint8_t r_idx = (row < 8) ? 0 : 1;
        uint8_t r_shift = (row < 8) ? row : (row - 8);
        uint8_t mask = (uint8_t)(0x80 >> r_shift);

        for (uint8_t col = 0; col < 6; col++)
        {
            uint8_t byteVal = Font6x12[idx][col * 2 + r_idx];
            if (byteVal & mask)
            {
                LCD_WriteByte_SPI(hiText);
                LCD_WriteByte_SPI(loText);
            }
            else
            {
                LCD_WriteByte_SPI(hiBg);
                LCD_WriteByte_SPI(loBg);
            }
        }
    }

    LCD_CS_PORT->BSRR = LCD_CS_PIN;
    LCD_SPI_Delay();
}

void LCD_DrawString6x12Ex(uint16_t x, uint16_t y, const char *str, uint16_t textColor, uint16_t bgColor)
{
    while (*str)
    {
        if (x + 6 > LCD_WIDTH) break;
        LCD_DrawChar6x12Ex(x, y, *str++, textColor, bgColor);
        x += 6;
    }
}

void LCD_DisplayChar(uint16_t Line, uint16_t Column, uint8_t Ascii)
{
    LCD_DrawChar((uint16_t)(Column * 8), (uint16_t)(Line * 16), (char)Ascii);
}

void LCD_DisplayStringLine(uint16_t Line, uint8_t *ptr)
{
    uint16_t y = Line * 16;
    LCD_FillRect(0, y, LCD_WIDTH, 16, s_BackColor);
    LCD_DrawString(0, y, (const char *)ptr);
}

void LCD_ClearLine(uint16_t Line)
{
    LCD_FillRect(0, Line * 16, LCD_WIDTH, 16, s_BackColor);
}

/* ========================================================================== */
/*                GIAO DIỆN GIÁM SÁT CAN VÀ IN LOG TỰ ĐỘNG CUỘN               */
/* ========================================================================== */
void LCD_Init_UI(void)
{
    LCD_Init_Portrait_UI();
}

/* ========================================================================== */
/*                GIAO DIỆN DỌC (PORTRAIT UI) CHUẨN DEMO BOSCH                */
/* ========================================================================== */
#define MAX_CAN_LOG_LINES 9
static char s_CanLogRecords[MAX_CAN_LOG_LINES][40];
static uint16_t s_CanLogColors[MAX_CAN_LOG_LINES];

void LCD_Init_Portrait_UI(void)
{
    LCD_Clear(LCD_COLOR_BLACK);

    /* Tiêu đề nhóm (Màu xanh lá, căn giữa) */
    LCD_DrawStringEx(64, 14, "NHOM 4 - BOSCH", LCD_COLOR_GREEN, LCD_COLOR_BLACK);
    LCD_DrawStringEx(20, 32, "-------------------------", LCD_COLOR_CYAN, LCD_COLOR_BLACK);

    /* Tiêu đề phần 1: CAN BUS */
    LCD_DrawStringEx(16, 50, "[BAI 1: CAN COMMUNICATION]", LCD_COLOR_YELLOW, LCD_COLOR_BLACK);

    /* Vạch phân chia giữa phần tóm tắt và phần Log Recording */
    LCD_DrawStringEx(20, 128, "-------------------------", LCD_COLOR_CYAN, LCD_COLOR_BLACK);

    /* Tiêu đề phần Log Recording theo đúng tiêu chuẩn chấm điểm */
    LCD_DrawStringEx(16, 146, "[CAN LOG RECORDING]", LCD_COLOR_YELLOW, LCD_COLOR_BLACK);

    /* Xóa sạch bộ đệm các dòng log ban đầu */
    for (uint8_t i = 0; i < MAX_CAN_LOG_LINES; i++)
    {
        s_CanLogRecords[i][0] = '\0';
        s_CanLogColors[i] = LCD_COLOR_WHITE;
    }

    /* Nạp giá trị ban đầu cho phần tóm tắt */
    LCD_Update_Portrait_UI(0x22, 0x33, 0x00, 0x012, 0x22, 0x33, 0x55, 0xA1);
}

void LCD_Update_Portrait_UI(uint8_t rx_b0, uint8_t rx_b1, uint8_t rx_cnt,
                            uint16_t tx_id, uint8_t tx_b0, uint8_t tx_b1, uint8_t tx_b2, uint8_t tx_crc)
{
    char line_buf[36];

    /* Dòng 1 (Y = 68): RX 0xA2: 22 33 (Cnt:06) */
    snprintf(line_buf, sizeof(line_buf), "RX 0xA2: %02X %02X (Cnt:%02X) ", rx_b0, rx_b1, rx_cnt);
    LCD_DrawStringEx(16, 68, line_buf, LCD_COLOR_WHITE, LCD_COLOR_BLACK);

    /* Dòng 2 (Y = 88): TX 012: 22 33 55 */
    snprintf(line_buf, sizeof(line_buf), "TX %03X: %02X %02X %02X   ", tx_id, tx_b0, tx_b1, tx_b2);
    LCD_DrawStringEx(16, 88, line_buf, LCD_COLOR_WHITE, LCD_COLOR_BLACK);

    /* Dòng 3 (Y = 108): CRC-8  : 0xA1 */
    snprintf(line_buf, sizeof(line_buf), "CRC-8  : 0x%02X     ", tx_crc);
    LCD_DrawStringEx(16, 108, line_buf, LCD_COLOR_WHITE, LCD_COLOR_BLACK);
}

void LCD_AddLogRecord(const char *log_text, uint16_t color)
{
    /* Đẩy các dòng log cũ trôi xuống dưới 1 dòng (các log chạy từ trên xuống) */
    for (int8_t i = MAX_CAN_LOG_LINES - 1; i > 0; i--)
    {
        strncpy(s_CanLogRecords[i], s_CanLogRecords[i - 1], sizeof(s_CanLogRecords[0]) - 1);
        s_CanLogRecords[i][sizeof(s_CanLogRecords[0]) - 1] = '\0';
        s_CanLogColors[i] = s_CanLogColors[i - 1];
    }

    /* Đưa dòng log mới nhất vào dòng đầu tiên trên cùng (index 0) */
    strncpy(s_CanLogRecords[0], log_text, sizeof(s_CanLogRecords[0]) - 1);
    s_CanLogRecords[0][sizeof(s_CanLogRecords[0]) - 1] = '\0';
    s_CanLogColors[0] = color;

    /* Vẽ lại các dòng log trôi từ trên xuống bằng Font 6x12 (Y từ 166 đến 286) */
    for (uint8_t i = 0; i < MAX_CAN_LOG_LINES; i++)
    {
        uint16_t y = 166 + i * 15;
        if (s_CanLogRecords[i][0] != '\0')
        {
            LCD_DrawString6x12Ex(16, y, s_CanLogRecords[i], s_CanLogColors[i], LCD_COLOR_BLACK);
        }
    }
}

void LCD_DisplayCANLog(uint16_t can_id, const uint8_t *data, uint8_t is_rx)
{
    /* Hàm tương thích cũ, không làm gián đoạn UI dọc */
    (void)can_id;
    (void)data;
    (void)is_rx;
}

/* ========================================================================== */
/*             CHUYỂN ĐỔI CHÂN PB6 GIỮA LCD_BL VÀ CAN2_TX                     */
/* ========================================================================== */
void LCD_Switch_To_LCD(void)
{
    HAL_GPIO_DeInit(GPIOB, GPIO_PIN_6);

    GPIO_InitTypeDef GPIO_InitStruct = {0};
    GPIO_InitStruct.Pin = LCD_BL_PIN;
    GPIO_InitStruct.Mode = GPIO_MODE_OUTPUT_PP;
    GPIO_InitStruct.Pull = GPIO_PULLUP;
    GPIO_InitStruct.Speed = GPIO_SPEED_FREQ_HIGH;
    HAL_GPIO_Init(LCD_BL_PORT, &GPIO_InitStruct);

    HAL_GPIO_WritePin(LCD_BL_PORT, LCD_BL_PIN, GPIO_PIN_SET);
}

void LCD_Switch_To_CAN2(void)
{
    HAL_GPIO_DeInit(GPIOB, GPIO_PIN_6);

    GPIO_InitTypeDef GPIO_InitStruct = {0};
    GPIO_InitStruct.Pin = GPIO_PIN_6;
    GPIO_InitStruct.Mode = GPIO_MODE_AF_PP;
    GPIO_InitStruct.Pull = GPIO_NOPULL;
    GPIO_InitStruct.Speed = GPIO_SPEED_FREQ_VERY_HIGH;
    GPIO_InitStruct.Alternate = GPIO_AF9_CAN2;
    HAL_GPIO_Init(GPIOB, &GPIO_InitStruct);
}
