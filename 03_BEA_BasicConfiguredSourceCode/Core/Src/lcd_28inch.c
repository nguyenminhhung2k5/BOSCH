/**
  ******************************************************************************
  * @file    lcd_28inch.c
  * @brief   Driver source for Waveshare 2.8inch Touch LCD (ST7789 / HX8347D)
  *          Optimized for Open405R-C and BOSCH CAN Assignment
  ******************************************************************************
  */

#include "lcd_28inch.h"
#include <stdio.h>
#include <string.h>

/* Bảng mã Font ASCII 8x16 chuẩn (từ ký tự ' ' 0x20 đến '~' 0x7E) */
static const uint8_t Font8x16[95][16] = {
    {0x00,0x00,0x00,0x00,0x00,0x00,0x00,0x00,0x00,0x00,0x00,0x00,0x00,0x00,0x00,0x00}, /*   0x20 */
    {0x00,0x00,0x18,0x3C,0x3C,0x3C,0x18,0x18,0x18,0x00,0x18,0x18,0x00,0x00,0x00,0x00}, /* ! 0x21 */
    {0x00,0x66,0x66,0x66,0x24,0x00,0x00,0x00,0x00,0x00,0x00,0x00,0x00,0x00,0x00,0x00}, /* " 0x22 */
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    {0x00,0x76,0xDC,0x00,0x00,0x00,0x00,0x00,0x00,0x00,0x00,0x00,0x00,0x00,0x00,0x00}  /* ~ 0x7E */
};

/* Biến lưu trữ dòng log hiện tại trên màn hình */
static uint8_t current_log_line = 3;  /* Bắt đầu từ dòng 3 (dưới header) */
#define MAX_LOG_LINES   13            /* Tối đa 13 dòng log (từ dòng 3 đến 13) */

/* Giao tiếp SPI tốc độ cao bằng thanh ghi GPIO BSRR (1 chu kỳ lệnh) */
static inline void LCD_WriteByte_SPI(uint8_t data)
{
    for (uint8_t i = 0; i < 8; i++)
    {
        if (data & 0x80)
            LCD_MOSI_PORT->BSRR = LCD_MOSI_PIN;
        else
            LCD_MOSI_PORT->BSRR = (uint32_t)LCD_MOSI_PIN << 16;

        LCD_SCK_PORT->BSRR = LCD_SCK_PIN;          /* Clock High */
        data <<= 1;
        LCD_SCK_PORT->BSRR = (uint32_t)LCD_SCK_PIN << 16; /* Clock Low */
    }
}

/* Gửi 1 byte lệnh (Command) tới LCD */
static void LCD_Write_Command(uint8_t cmd)
{
    LCD_DC_PORT->BSRR = (uint32_t)LCD_DC_PIN << 16; /* DC Low = Lệnh */
    LCD_CS_PORT->BSRR = (uint32_t)LCD_CS_PIN << 16; /* CS Low = Chọn chip */
    LCD_WriteByte_SPI(cmd);
    LCD_CS_PORT->BSRR = LCD_CS_PIN;                 /* CS High */
}

/* Gửi 1 byte dữ liệu (Data) tới LCD */
static void LCD_Write_Data(uint8_t data)
{
    LCD_DC_PORT->BSRR = LCD_DC_PIN;                 /* DC High = Dữ liệu */
    LCD_CS_PORT->BSRR = (uint32_t)LCD_CS_PIN << 16; /* CS Low */
    LCD_WriteByte_SPI(data);
    LCD_CS_PORT->BSRR = LCD_CS_PIN;                 /* CS High */
}

/* Khởi tạo GPIO cho LCD */
void LCD_GPIO_Init(void)
{
    __HAL_RCC_GPIOA_CLK_ENABLE();
    __HAL_RCC_GPIOB_CLK_ENABLE();

    GPIO_InitTypeDef GPIO_InitStruct = {0};

    /* MOSI (PA7) */
    GPIO_InitStruct.Pin = LCD_MOSI_PIN;
    GPIO_InitStruct.Mode = GPIO_MODE_OUTPUT_PP;
    GPIO_InitStruct.Pull = GPIO_NOPULL;
    GPIO_InitStruct.Speed = GPIO_SPEED_FREQ_VERY_HIGH;
    HAL_GPIO_Init(LCD_MOSI_PORT, &GPIO_InitStruct);

    /* SCLK (PB3), RST (PB2), BL (PB6), CS (PB7), DC (PB8) */
    GPIO_InitStruct.Pin = LCD_SCK_PIN | LCD_RST_PIN | LCD_BL_PIN | LCD_CS_PIN | LCD_DC_PIN;
    HAL_GPIO_Init(GPIOB, &GPIO_InitStruct);

    /* Mức ban đầu */
    HAL_GPIO_WritePin(LCD_CS_PORT, LCD_CS_PIN, GPIO_PIN_SET);
    HAL_GPIO_WritePin(LCD_DC_PORT, LCD_DC_PIN, GPIO_PIN_SET);
    HAL_GPIO_WritePin(LCD_SCK_PORT, LCD_SCK_PIN, GPIO_PIN_RESET);
    HAL_GPIO_WritePin(LCD_BL_PORT, LCD_BL_PIN, GPIO_PIN_SET); /* Bật đèn nền */
}

/* Bật / Tắt đèn nền LCD */
void LCD_SetBacklight(uint8_t state)
{
    HAL_GPIO_WritePin(LCD_BL_PORT, LCD_BL_PIN, state ? GPIO_PIN_SET : GPIO_PIN_RESET);
}

/* Khởi động màn hình LCD */
void LCD_Init(void)
{
    LCD_GPIO_Init();

    /* Reset phần cứng LCD */
    HAL_GPIO_WritePin(LCD_RST_PORT, LCD_RST_PIN, GPIO_PIN_RESET);
    HAL_Delay(50);
    HAL_GPIO_WritePin(LCD_RST_PORT, LCD_RST_PIN, GPIO_PIN_SET);
    HAL_Delay(120);

#if defined(ST7789_DEVICE)
    /* Chuỗi khởi tạo cho IC ST7789 */
    LCD_Write_Command(0x11); /* Sleep Out */
    HAL_Delay(120);

    LCD_Write_Command(0x36); /* Memory Data Access Control */
    LCD_Write_Data(0x70);    /* Landscape mode (Nằm ngang 320x240) */

    LCD_Write_Command(0x3A); /* Pixel Format */
    LCD_Write_Data(0x05);    /* 16-bit RGB 565 */

    LCD_Write_Command(0xB2); /* Porch Setting */
    LCD_Write_Data(0x0C); LCD_Write_Data(0x0C);
    LCD_Write_Data(0x00); LCD_Write_Data(0x33); LCD_Write_Data(0x33);

    LCD_Write_Command(0xB7); /* Gate Control */
    LCD_Write_Data(0x35);

    LCD_Write_Command(0xBB); /* VCOM Setting */
    LCD_Write_Data(0x19);

    LCD_Write_Command(0xC0); /* LCM Control */
    LCD_Write_Data(0x2C);

    LCD_Write_Command(0xC2); /* VDV and VRH Command Enable */
    LCD_Write_Data(0x01);

    LCD_Write_Command(0xC3); /* VRH Set */
    LCD_Write_Data(0x12);

    LCD_Write_Command(0xC4); /* VDV Set */
    LCD_Write_Data(0x20);

    LCD_Write_Command(0xC6); /* Frame Rate Control */
    LCD_Write_Data(0x0F);    /* 60Hz */

    LCD_Write_Command(0xD0); /* Power Control 1 */
    LCD_Write_Data(0xA4); LCD_Write_Data(0xA1);

    LCD_Write_Command(0x21); /* Display Inversion On */
    HAL_Delay(10);

    LCD_Write_Command(0x29); /* Display On */
    HAL_Delay(50);
#elif defined(HX8347_DEVICE)
    /* Chuỗi khởi tạo cho IC HX8347D */
    LCD_Write_Command(0xEA); LCD_Write_Data(0x00);
    LCD_Write_Command(0xEB); LCD_Write_Data(0x20);
    LCD_Write_Command(0xEC); LCD_Write_Data(0x0C);
    LCD_Write_Command(0xED); LCD_Write_Data(0xC4);
    LCD_Write_Command(0x18); LCD_Write_Data(0x04);
    LCD_Write_Command(0x16); LCD_Write_Data(0x68); /* Landscape */
    LCD_Write_Command(0x2E); LCD_Write_Data(0x89);
    HAL_Delay(20);
    LCD_Write_Command(0x29); /* Display ON */
#endif

    LCD_Clear(LCD_BLACK);
}

/* Đặt vùng vẽ (Window) */
void LCD_SetWindow(uint16_t x0, uint16_t y0, uint16_t x1, uint16_t y1)
{
    LCD_Write_Command(0x2A); /* Column Addr Set */
    LCD_Write_Data(x0 >> 8);
    LCD_Write_Data(x0 & 0xFF);
    LCD_Write_Data(x1 >> 8);
    LCD_Write_Data(x1 & 0xFF);

    LCD_Write_Command(0x2B); /* Row Addr Set */
    LCD_Write_Data(y0 >> 8);
    LCD_Write_Data(y0 & 0xFF);
    LCD_Write_Data(y1 >> 8);
    LCD_Write_Data(y1 & 0xFF);

    LCD_Write_Command(0x2C); /* Memory Write */
}

/* Tô màu toàn màn hình */
void LCD_Clear(uint16_t color)
{
    LCD_SetWindow(0, 0, LCD_WIDTH - 1, LCD_HEIGHT - 1);

    LCD_DC_PORT->BSRR = LCD_DC_PIN;
    LCD_CS_PORT->BSRR = (uint32_t)LCD_CS_PIN << 16;

    uint8_t hi = color >> 8;
    uint8_t lo = color & 0xFF;

    for (uint32_t i = 0; i < (LCD_WIDTH * LCD_HEIGHT); i++)
    {
        LCD_WriteByte_SPI(hi);
        LCD_WriteByte_SPI(lo);
    }

    LCD_CS_PORT->BSRR = LCD_CS_PIN;
}

/* Vẽ hình chữ nhật đặc */
void LCD_FillRect(uint16_t x, uint16_t y, uint16_t w, uint16_t h, uint16_t color)
{
    if (x >= LCD_WIDTH || y >= LCD_HEIGHT) return;
    if (x + w > LCD_WIDTH)  w = LCD_WIDTH - x;
    if (y + h > LCD_HEIGHT) h = LCD_HEIGHT - y;

    LCD_SetWindow(x, y, x + w - 1, y + h - 1);

    LCD_DC_PORT->BSRR = LCD_DC_PIN;
    LCD_CS_PORT->BSRR = (uint32_t)LCD_CS_PIN << 16;

    uint8_t hi = color >> 8;
    uint8_t lo = color & 0xFF;
    uint32_t total = w * h;

    for (uint32_t i = 0; i < total; i++)
    {
        LCD_WriteByte_SPI(hi);
        LCD_WriteByte_SPI(lo);
    }

    LCD_CS_PORT->BSRR = LCD_CS_PIN;
}

/* Vẽ 1 ký tự ASCII (kích thước 8x16) */
void LCD_DrawChar(uint16_t x, uint16_t y, char ch, uint16_t textColor, uint16_t bgColor)
{
    if (ch < 0x20 || ch > 0x7E) ch = ' ';
    uint8_t idx = ch - 0x20;

    LCD_SetWindow(x, y, x + 7, y + 15);

    LCD_DC_PORT->BSRR = LCD_DC_PIN;
    LCD_CS_PORT->BSRR = (uint32_t)LCD_CS_PIN << 16;

    uint8_t hiText = textColor >> 8;
    uint8_t loText = textColor & 0xFF;
    uint8_t hiBg   = bgColor >> 8;
    uint8_t loBg   = bgColor & 0xFF;

    for (uint8_t row = 0; row < 16; row++)
    {
        uint8_t line = Font8x16[idx][row];
        for (uint8_t col = 0; col < 8; col++)
        {
            if (line & (0x80 >> col))
            {
                LCD_WriteByte_SPI(hiText);
                LCD_WriteByte_SPI(loText);
            }
            else
            {
                LCD_WriteByte_SPI(hiBg);
                LCD_WriteByte_SPI(loBg);
            }
        }
    }

    LCD_CS_PORT->BSRR = LCD_CS_PIN;
}

/* In chuỗi ký tự ra màn hình */
void LCD_DrawString(uint16_t x, uint16_t y, const char *str, uint16_t textColor, uint16_t bgColor)
{
    while (*str)
    {
        if (x + 8 > LCD_WIDTH)
        {
            x = 0;
            y += 16;
            if (y + 16 > LCD_HEIGHT) break;
        }
        LCD_DrawChar(x, y, *str++, textColor, bgColor);
        x += 8;
    }
}

/* Khởi tạo giao diện UI giám sát CAN Monitor chuyên nghiệp */
void LCD_Init_UI(void)
{
    /* Xóa nền đen */
    LCD_Clear(LCD_BLACK);

    /* Banner tiêu đề trên cùng (Nền xanh đen) */
    LCD_FillRect(0, 0, LCD_WIDTH, 22, LCD_DARKBLUE);
    LCD_DrawString(16, 3, "BOSCH CAN MONITOR - NODE 1", LCD_YELLOW, LCD_DARKBLUE);

    /* Dòng trạng thái (Status bar) */
    LCD_FillRect(0, 23, LCD_WIDTH, 18, LCD_DARKGRAY);
    LCD_DrawString(8, 25, "Baud: 500k | Cycle: 50ms | ID: 0x012", LCD_WHITE, LCD_DARKGRAY);

    /* Đường kẻ phân cách */
    LCD_FillRect(0, 42, LCD_WIDTH, 2, LCD_GRAY);

    current_log_line = 3;
}

/* In bản tin CAN lên màn hình LCD (Tự động cuộn dòng) */
void LCD_DisplayCANLog(uint16_t can_id, const uint8_t *data, uint8_t is_rx)
{
    char log_buf[40];

    /* Format chuỗi log: ví dụ "RX 0A2: 04 05 00 00 00 00 2C 00" */
    sprintf(log_buf, "%s %03X: %02X %02X %02X %02X %02X %02X %02X %02X",
            is_rx ? "RX" : "TX",
            can_id,
            data[0], data[1], data[2], data[3],
            data[4], data[5], data[6], data[7]);

    uint16_t y_pos = 46 + (current_log_line - 3) * 16;

    /* Xóa nền dòng này trước khi ghi đè */
    LCD_FillRect(0, y_pos, LCD_WIDTH, 16, LCD_BLACK);

    /* Màu sắc trực quan: RX màu Cyan, TX màu Xanh lá (Green) */
    uint16_t textColor = is_rx ? LCD_CYAN : LCD_GREEN;

    LCD_DrawString(4, y_pos, log_buf, textColor, LCD_BLACK);

    /* Tăng dòng tiếp theo (Cuộn lại dòng đầu khi đầy) */
    current_log_line++;
    if (current_log_line > MAX_LOG_LINES)
    {
        current_log_line = 3;
    }
}

/* ============================================================
 * HÀM RE-INIT GPIO CHUYỂN ĐỔI CHÂN PB6 (CỘNG 1 ĐIỂM ĐỀ BÀI)
 * ============================================================ */

/* Chuyển chân PB6 sang điều khiển màn hình LCD (Đèn nền LCD_BL) */
void LCD_Switch_To_LCD(void)
{
    HAL_GPIO_DeInit(GPIOB, GPIO_PIN_6);

    GPIO_InitTypeDef GPIO_InitStruct = {0};
    GPIO_InitStruct.Pin = LCD_BL_PIN;
    GPIO_InitStruct.Mode = GPIO_MODE_OUTPUT_PP;
    GPIO_InitStruct.Pull = GPIO_NOPULL;
    GPIO_InitStruct.Speed = GPIO_SPEED_FREQ_HIGH;
    HAL_GPIO_Init(LCD_BL_PORT, &GPIO_InitStruct);

    HAL_GPIO_WritePin(LCD_BL_PORT, LCD_BL_PIN, GPIO_PIN_SET); /* Bật đèn sáng */
}

/* Chuyển chân PB6 sang làm CAN2_TX nếu cần */
void LCD_Switch_To_CAN2(void)
{
    HAL_GPIO_DeInit(GPIOB, GPIO_PIN_6);

    GPIO_InitTypeDef GPIO_InitStruct = {0};
    GPIO_InitStruct.Pin = GPIO_PIN_6;
    GPIO_InitStruct.Mode = GPIO_MODE_AF_PP;
    GPIO_InitStruct.Pull = GPIO_NOPULL;
    GPIO_InitStruct.Speed = GPIO_SPEED_FREQ_VERY_HIGH;
    GPIO_InitStruct.Alternate = GPIO_AF9_CAN2;
    HAL_GPIO_Init(GPIOB, &GPIO_InitStruct);
}
